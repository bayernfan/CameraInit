#include "lcd.h"

#define TTY_ROW_GAP 4

#define TTY_COL_GAP 1

#define TTY_ROW_HEIGHT (ASCII_HEIGHT + TTY_ROW_GAP)

#define TTY_COL_WIDTH (ASCII_WIDTH + TTY_COL_GAP)

#define TTY_N_ROWS ((LCD_width + TTY_ROW_GAP) / TTY_ROW_HEIGHT)

#define TTY_N_COLS ((LCD_height + TTY_COL_GAP) / TTY_COL_WIDTH)

#define ASC_OF(N) ((N) > 32 && (N) < 127 ? ASCII[(N) - 32] : ASCII[0])

#define TTY_eraseAll() LCD_fillScreen(backColor_cache)

#define TTY_writeASCII(i_row, i_col, ch, color) \
     LCD_writeASCII((i_col) * TTY_COL_WIDTH, LCD_width - \
     (i_row) * TTY_ROW_HEIGHT - ASCII_HEIGHT, (ch), (color))

static uint16_t volatile ASCII_row = 0;

static uint16_t volatile ASCII_col = 0;

static uint16_t volatile backColor_cache = BLACK;

static void TTY_eraseRow(uint16_t i_row);

static uint8_t const ASCII[][ASCII_WIDTH] = {
    { 0x00, 0x00, 0x00, 0x00, 0x00 }, // 32 = (space)
    { 0x00, 0x00, 0x5F, 0x00, 0x00 }, // 33 = !
    { 0x00, 0x03, 0x00, 0x03, 0x00 }, // 34 = "
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    { 0x08, 0x04, 0x08, 0x10, 0x08 } // 126 = ~
};

void TTY_printChar(uint8_t ch, uint16_t color) {
    if ('\n' == ch) {
        if (++ASCII_row == TTY_N_ROWS) {
            TTY_eraseAll();
            ASCII_row = 0;
        } else {
            TTY_eraseRow(ASCII_row);
        }
        ASCII_col = 0;
        return;
    }
    
    TTY_writeASCII(ASCII_row, ASCII_col, ch, color);
    
    if (++ASCII_col == TTY_N_COLS) {
        TTY_printChar('\n', color);
    }
}

void TTY_printString(char const *str, uint16_t color) {
    while (*str) TTY_printChar(*str++, color);
}

void TTY_eraseRow(uint16_t i_row) {
    uint16_t i_col;
    for (i_col = 0; i_col < TTY_N_COLS; i_col++)
        TTY_writeASCII(i_row, i_col, ' ', backColor_cache);
}


void LCD_writeASCII(uint16_t x0, uint16_t y0, uint8_t ch, uint16_t color) {
    static uint16_t volatile colors[ASCII_WIDTH * ASCII_HEIGHT];
    
    int i, j;
    uint8_t const* ascii = ASC_OF(ch);
    for (i = 0; i < ASCII_WIDTH; i++) {
        for (j = 0; j < ASCII_HEIGHT; j++) {
            colors[i * ASCII_HEIGHT + j] = (ascii[i] >> (ASCII_HEIGHT - 1 - j)) & 0x01 ? color : backColor_cache;
        }
    }
    
    LCD_setAddrWindow(x0, y0, x0 + ASCII_WIDTH - 1, y0 + ASCII_HEIGHT - 1);    
    LCD_pushColor((uint16_t *)colors, ASCII_WIDTH * ASCII_HEIGHT);
}

void LCD_fillScreen(uint16_t color) {
    static uint16_t volatile colors[LCD_width];
    uint16_t volatile i;
    
    if (backColor_cache == color) {
        i = 0;
    } else {
        backColor_cache = color;   
        i = LCD_width;
        while (i != 0)
            colors[--i] = color;
    }
    
    LCD_setAddrWindow(0, 0, LCD_height, LCD_width);
    while (i++ < LCD_height)
        LCD_pushColor((uint16_t *)colors, LCD_width);
}
